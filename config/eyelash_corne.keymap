#include <input/processors.dtsi>
#include <zephyr/dt-bindings/input/input-event-codes.h>
#include <behaviors.dtsi>

#include <dt-bindings/zmk/bt.h>
#include <dt-bindings/zmk/keys.h>
#include <dt-bindings/zmk/outputs.h>
#include <dt-bindings/zmk/pointing.h>
#include <dt-bindings/zmk/rgb.h>
#include <dt-bindings/zmk/behaviors.h>

#include <zmk-helpers/helper.h>

#include "eyelash_corne_keylabels.h"


#define XXX &none
#define ___ &trans

#define DEFAULT 0
#define NAV     1
#define NUM     2
#define SYM     3
#define MOUSE   4
#define FUNC    5

/*  --------------   */
/*  Global defaults  */
/*  --------------   */

#define QUICK_TAP_MS 175

&sk { // Sticky Key
  release-after-ms = <900>;
  quick-release;
};

&sl { // Sticky Layer - Allow sticky mods to chord across sticky layers.
  release-after-ms = <2000>;
  ignore-modifiers;
};

&lt { // Layer Tap
  flavor = "balanced";
  tapping-term-ms = <200>;
  quick-tap-ms = <QUICK_TAP_MS>;
};

/*  ---------------  */
/*  Custom Behaviors */
/*  ---------------  */

#include "behaviors/mouse.dtsi"

// Smart-mouse, requires tri-state module.
ZMK_TRI_STATE(
    smart_mouse, bindings = <&tog MOUSE>, <&none>, <&tog MOUSE>;
    ignored-key-positions =
        <RT2 RM1 RM2 RM3 RB1 RB3 RB4 RB5>;
    ignored-layers = <MOUSE NAV>;)

#include "behaviors/macros.dtsi"

// Use concrete layer indexes for combos instead of zmk-helpers' 0xff ALL alias.
#undef ALL
#define ALL DEFAULT NAV NUM SYM MOUSE FUNC

#include "behaviors/combos.dtsi"

#include "behaviors/num_word.dtsi" 
#include "behaviors/nav_word.dtsi" 

#include "behaviors/home_row_mods.dtsi" 

#include "behaviors/magic_shift.dtsi"
#include "behaviors/super_copy.dtsi"




/*  --------------  */
/*    Custom Keys   */
/*  --------------  */ 

#define SIMPLE_MORPH(NAME, MOD, BINDING1, BINDING2)           \
  ZMK_MOD_MORPH(NAME, mods = <(MOD_L##MOD | MOD_R##MOD)>;     \
                bindings = <BINDING1>, <BINDING2>;)

SIMPLE_MORPH(cma_smcln,  SFT,   &kp COMMA,   &kp SEMICOLON)
SIMPLE_MORPH(at_hash,    SFT,   &kp AT,      &kp HASH)

// Tap: backspace | Lshft + tap: delete | Rshft + tap: shift-delete.
ZMK_MOD_MORPH(bs_del, bindings = <&kp BSPC>, <&kp DEL>;
              mods = <(MOD_LSFT|MOD_RSFT)>; keep-mods = <MOD_RSFT>;)

// Alt+Tab swapper, requires tri-state module.
ZMK_TRI_STATE(swapper, bindings = <&kt LGUI>, <&kp TAB>, <&kt LGUI>;
              ignored-key-positions = <RM1 RM2 RM3 RT2>;)


// Tap: sticky SYM  | Hold: SYM-layer.
#define SMART_SYM &smart_sym SYM SYM
ZMK_HOLD_TAP(smart_sym, bindings = <&mo>, <&sl>; flavor = "balanced";
             tapping-term-ms = <200>; quick-tap-ms = <QUICK_TAP_MS>;)

/*  --------------  */
/*  Custom Actions  */
/*  --------------  */

// Tap: Undo | Double-tap: Redo
ZMK_TAP_DANCE(undo_redo, bindings = <&undo>, <&redo>;
              tapping-term-ms = <200>;)


#define ZMK_BASE_LAYER(name, LT, JT, RT, LM, JM, RM, LB, JB, RB, LH, RH)      \
  ZMK_LAYER(                                                                  \
      name,                                                                   \
      LT JT RT                                                                \
      LM JM RM                                                                \
      LB JB RB                                                                \
      LH    RH                                                                \
  )

ZMK_BASE_LAYER(Enthium,
//╭─────────────┬───────────────┬───────────────┬──────────────┬─────────────┬──────────────╮ ╭─────────────┬─────────────┬─────────────╮ ╭─────────────┬─────────────┬─────────────┬─────────────┬─────────────┬─────────────╮
      &kp ESC         &kp Q           &kp Y           &kp O         &kp U     &cp_pst_cut_mv,                    U_MS_U                 ,     &kp X         &kp L         &kp D         &kp W         &kp Z       &undo_redo  ,
//├─────────────┼───────────────┼───────────────┼──────────────┼─────────────┼──────────────┤ ├─────────────┼─────────────┼─────────────┤ ├─────────────┼─────────────┼─────────────┼─────────────┼─────────────┼─────────────┤
      &kp B           &kp C           &kp I           &kp A         &kp E       &cma_smcln  ,      U_MS_L      &mkp LCLK       U_MS_R   ,     &kp K         &kp H         &kp T         &kp N         &kp S         &kp F     ,
//├─────────────┼───────────────┼───────────────┼──────────────┼─────────────┼──────────────┤ ├─────────────┼─────────────┼─────────────┤ ├─────────────┼─────────────┼─────────────┼─────────────┼─────────────┼─────────────┤
      &bs_del     &hml LCTL SQT  &hml LALT MINUS  &lg_qns_excl  &ls_dot_colon    &at_hash   ,      XXX           U_MS_D                 ,     &kp J     &hmr RSHFT M   &hmr RGUI G   &hmr RALT P  &hmr RCTRL V    &kp ENTER   ,
//╰─────────────┴───────────────┴───────────────┼──────────────┼─────────────┼──────────────┤ ╰─────────────┴─────────────┴─────────────╯ ├─────────────┼─────────────┼─────────────┼─────────────┴─────────────┴─────────────╯
                                                    SMART_NUM     &kp SPACE     SMART_NAV   ,                                              MAGIC_SHIFT      &kp R       SMART_SYM
//                                              ╰──────────────┴─────────────┴──────────────╯                                             ╰─────────────┴─────────────┴─────────────╯
)

ZMK_BASE_LAYER(Nav,
//╭─────────────┬───────────────┬───────────────┬──────────────┬─────────────┬─────────────╮ ╭─────────────┬─────────────┬─────────────╮ ╭─────────────┬─────────────┬─────────────┬─────────────┬─────────────┬─────────────╮
        XXX            XXX            &kp UP           XXX           XXX           XXX     ,                   &zoom_in                ,       XXX           XXX         &kp UP          XXX           XXX           XXX     ,
//├─────────────┼───────────────┼───────────────┼──────────────┼─────────────┼─────────────┤ ├─────────────┼─────────────┼─────────────┤ ├─────────────┼─────────────┼─────────────┼─────────────┼─────────────┼─────────────┤
        XXX          &kp LEFT        &kp DOWN       &kp RIGHT        XXX           XXX     ,       XXX       &zoom_reset       XXX     ,       XXX        &kp LEFT      &kp DOWN      &kp RIGHT        XXX         &swapper  ,
//├─────────────┼───────────────┼───────────────┼──────────────┼─────────────┼─────────────┤ ├─────────────┼─────────────┼─────────────┤ ├─────────────┼─────────────┼─────────────┼─────────────┼─────────────┼─────────────┤
        ___         &kp LCTRL        &kp LALT        &kp LGUI     &kp LSHFT        XXX     ,       XXX        &zoom_out                ,       XXX        &prev_desk       XXX        &next_desk       XXX           ___     ,
//╰─────────────┴───────────────┴───────────────┼──────────────┼─────────────┼─────────────┤ ╰─────────────┴─────────────┴─────────────╯ ├─────────────┼─────────────┼─────────────┼─────────────┴─────────────┴─────────────╯
                                                       ___           ___          ___      ,                                                   ___           ___           ___
//                                              ╰──────────────┴─────────────┴─────────────╯                                             ╰─────────────┴─────────────┴─────────────╯
)

ZMK_BASE_LAYER(Num,
//╭─────────────┬───────────────┬───────────────┬──────────────┬─────────────┬─────────────╮ ╭─────────────┬─────────────┬─────────────╮ ╭─────────────┬─────────────┬─────────────┬─────────────┬─────────────┬─────────────╮
        ___         &close_app     &close_win         &find       &refresh      &new_file  ,                 &kp C_VOL_UP              , &kp KP_MULTIPLY  &kp KP_N7     &kp KP_N8     &kp KP_N9     &kp DLLR         XXX     ,
//├─────────────┼───────────────┼───────────────┼──────────────┼─────────────┼─────────────┤ ├─────────────┼─────────────┼─────────────┤ ├─────────────┼─────────────┼─────────────┼─────────────┼─────────────┼─────────────┤
        ___        &select_all     &save_file          XXX           XXX        &new_tab   ,   &kp C_PREV     &kp C_PP      &kp C_NEXT ,   &kp KP_PLUS    &kp KP_N4     &kp KP_N5     &kp KP_N6   &kp KP_MINUS   &kp KP_EQUAL,
//├─────────────┼───────────────┼───────────────┼──────────────┼─────────────┼─────────────┤ ├─────────────┼─────────────┼─────────────┤ ├─────────────┼─────────────┼─────────────┼─────────────┼─────────────┼─────────────┤
        ___           &undo           &redo            XXX      &quick_cmd_tab  &kp ENTER  ,       XXX       &kp C_VOL_DN              ,  &kp KP_DIVIDE   &kp KP_N1     &kp KP_N2     &kp KP_N3     &kp COLON        ___     ,
//╰─────────────┴───────────────┴───────────────┼──────────────┼─────────────┼─────────────┤ ╰─────────────┴─────────────┴─────────────╯ ├─────────────┼─────────────┼─────────────┼─────────────┴─────────────┴─────────────╯
                                                       ___           ___           ___     ,                                                &kp KP_DOT    &kp KP_N0     &kp COMMA
//                                              ╰──────────────┴─────────────┴─────────────╯                                             ╰─────────────┴─────────────┴─────────────╯
)

ZMK_BASE_LAYER(Symbols,
//╭─────────────┬───────────────┬───────────────┬──────────────┬─────────────┬─────────────╮ ╭─────────────┬─────────────┬─────────────╮ ╭─────────────┬─────────────┬─────────────┬─────────────┬─────────────┬─────────────╮
        ___            ___          &kp LT          &kp GT        &kp PIPE      &kp DLLR   ,                     XXX                   ,       XXX           XXX           XXX           XXX           XXX           XXX     ,
//├─────────────┼───────────────┼───────────────┼──────────────┼─────────────┼─────────────┤ ├─────────────┼─────────────┼─────────────┤ ├─────────────┼─────────────┼─────────────┼─────────────┼─────────────┼─────────────┤
        XXX        &kp TILDE        &kp ASTRK       &kp FSLH      &kp EQUAL     &kp AMPS   ,       XXX           XXX           XXX     ,       XXX           XXX           XXX           XXX           XXX           XXX     ,
//├─────────────┼───────────────┼───────────────┼──────────────┼─────────────┼─────────────┤ ├─────────────┼─────────────┼─────────────┤ ├─────────────┼─────────────┼─────────────┼─────────────┼─────────────┼─────────────┤
        ___        &kp GRAVE        &kp MINUS       &kp PLUS      &kp PRCNT     &kp CARET  ,       XXX           XXX                   ,       XXX           XXX           XXX           XXX           XXX           ___     ,
//╰─────────────┴───────────────┴───────────────┼──────────────┼─────────────┼─────────────┤ ╰─────────────┴─────────────┴─────────────╯ ├─────────────┼─────────────┼─────────────┼─────────────┴─────────────┴─────────────╯
                                                       ___           ___           ___     ,                                                   ___           ___           ___
//                                              ╰──────────────┴─────────────┴─────────────╯                                             ╰─────────────┴─────────────┴─────────────╯
)

ZMK_BASE_LAYER(Mouse,
//╭─────────────┬───────────────┬───────────────┬──────────────┬─────────────┬─────────────╮ ╭─────────────┬─────────────┬─────────────╮ ╭─────────────┬─────────────┬─────────────┬─────────────┬─────────────┬─────────────╮
        ___            XXX             XXX            XXX            XXX           XXX     ,                     XXX                   ,       XXX           XXX          U_MS_U         XXX           XXX           XXX     ,
//├─────────────┼───────────────┼───────────────┼──────────────┼─────────────┼─────────────┤ ├─────────────┼─────────────┼─────────────┤ ├─────────────┼─────────────┼─────────────┼─────────────┼─────────────┼─────────────┤
        XXX            XXX             XXX            XXX            XXX           XXX     ,       XXX           XXX           XXX     ,       XXX          U_MS_L        U_MS_D       U_MS_R          XXX           XXX     ,
//├─────────────┼───────────────┼───────────────┼──────────────┼─────────────┼─────────────┤ ├─────────────┼─────────────┼─────────────┤ ├─────────────┼─────────────┼─────────────┼─────────────┼─────────────┼─────────────┤
        ___            XXX             XXX            XXX            XXX           XXX     ,       XXX           XXX                   ,       XXX        &mkp LCLK        XXX        &mkp RCLK        XXX           ___     ,
//╰─────────────┴───────────────┴───────────────┼──────────────┼─────────────┼─────────────┤ ╰─────────────┴─────────────┴─────────────╯ ├─────────────┼─────────────┼─────────────┼─────────────┴─────────────┴─────────────╯
                                                       ___           ___           ___     ,                                                   ___           ___           ___
//                                              ╰──────────────┴─────────────┴─────────────╯                                             ╰─────────────┴─────────────┴─────────────╯
)


ZMK_BASE_LAYER(Functions,
//╭─────────────┬───────────────┬───────────────┬──────────────┬─────────────┬─────────────╮ ╭───────────────┬───────────────┬───────────────╮ ╭─────────────┬─────────────┬───────────────┬───────────────┬───────────────┬───────────────╮
        XXX            XXX             XXX             XXX           XXX           XXX     ,                  &rgb_ug RGB_BRI                , &rgb_ug RGB_SPI     XXX            XXX             XXX             XXX              XXX      ,
//├─────────────┼───────────────┼───────────────┼──────────────┼─────────────┼─────────────┤ ├───────────────┼───────────────┼───────────────┤ ├─────────────┼─────────────┼───────────────┼───────────────┼───────────────┼───────────────┤
    &bt BT_CLR     &bt BT_SEL 0    &bt BT_SEL 1   &bt BT_SEL 2   &bt BT_SEL 3      XXX     ,  &rgb_ug RGB_EFF &rgb_ug RGB_TOG &rgb_ug RGB_EFR, &rgb_ug RGB_SPD     XXX            XXX             XXX             XXX              XXX      ,  
//├─────────────┼───────────────┼───────────────┼──────────────┼─────────────┼─────────────┤ ├───────────────┼───────────────┼───────────────┤ ├─────────────┼─────────────┼───────────────┼───────────────┼───────────────┼───────────────┤
    &bootloader        XXX             XXX             XXX           XXX           XXX     ,        XXX       &rgb_ug RGB_BRD                ,       XXX           XXX            XXX             XXX             XXX              XXX      ,
//╰─────────────┴───────────────┴───────────────┼──────────────┼─────────────┼─────────────┤ ╰───────────────┴───────────────┴───────────────╯ ├─────────────┼─────────────┼───────────────┼───────────────┴───────────────┴───────────────╯
                                                       XXX           XXX           XXX     ,                                                         XXX           XXX        &to DEFAULT
//                                              ╰──────────────┴─────────────┴─────────────╯                                                   ╰─────────────┴─────────────┴───────────────╯
)
