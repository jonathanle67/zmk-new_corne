## config/west.yml
```yaml
manifest:
  remotes:
    - name: zmkfirmware
      url-base: https://github.com/zmkfirmware
    - name: urob
      url-base: https://github.com/urob
    - name: gpeye                        
      url-base: https://github.com/GPeye 
    - name: kevinpastor
      url-base: https://github.com/kevinpastor

  projects:
    - name: eyelash_corne
      url: https://github.com/a741725193/zmk-new_corne
      revision: main
    - name: zmk
      remote: zmkfirmware
      revision: v0.3.0
      import: app/west.yml
    - name: zmk-helpers
      remote: urob
      revision: main

    # ZMK modules
    - name: zmk-adaptive-key
      remote: urob
      revision: v0.3
    - name: zmk-auto-layer
      remote: urob
      revision: v0.3
    - name: zmk-leader-key
      remote: urob
      revision: v0.3
    - name: zmk-tri-state
      remote: urob
      revision: v0.3
    - name: zmk-unicode
      remote: urob
      revision: v0.3
    
    # Custom Nice!View
    - name: hammerbeam-slideshow          
      remote: gpeye                       
      revision: main                
    - name: nice-view-elemental
      remote: kevinpastor
      revision: main
      
  self:
    path: config
```
